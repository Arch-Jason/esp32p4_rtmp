## main/Kconfig.projbuild
```kconfig
menu "Camera Configuration"
    config CAM_H
        int "Camera horizontal resolution"
        default 800
    config CAM_V
        int "Camera vertical resolution"
        default 640

    config WIFI_SSID
        string "WiFi SSID"
        default ""
    config WIFI_PASSWORD
        string "WiFi Password"
        default ""

    config WIFI_MAXIMUM_RETRY
        int "WiFi Maximum Retry"
        default 5

    config PORT
        int "Port"
        range 0 65535
        default 3333
        help
            Local port the example server will listen on.

    config KEEPALIVE_IDLE
        int "TCP keep-alive idle time(s)"
        default 5
        help
            Keep-alive idle time. In idle time without receiving any data from peer, will send keep-alive probe packet

    config KEEPALIVE_INTERVAL
        int "TCP keep-alive interval time(s)"
        default 5
        help
            Keep-alive probe packet interval time.

    config KEEPALIVE_COUNT
        int "TCP keep-alive packet retry send counts"
        default 3
        help
            Keep-alive probe packet retry count.

    config RTMP_SERVER_HOST
        string "RTMP server host"

    config RTMP_SERVER_PORT
        int "RTMP server port"
        range 0 65535
        default 1935

    config RTMP_APP
        string "App name"
        help
            the name before the slash

    config RTMP_STREAM
        string "Stream name"
        help
            the name after the slash
    
        choice EXAMPLE_SELECT_MIC_GAIN
        prompt "Set MIC gain"
        default MIC_GAIN_18DB
        help
            Select mic gain for echo mode

        config MIC_GAIN_0DB
            bool "0dB"
        config MIC_GAIN_6DB
            bool "6dB"
        config MIC_GAIN_12DB
            bool "12dB"
        config MIC_GAIN_18DB
            bool "18dB"
        config MIC_GAIN_24DB
            bool "24dB"
        config MIC_GAIN_30DB
            bool "30dB"
        config MIC_GAIN_36DB
            bool "36dB"
        config MIC_GAIN_42DB
            bool "42dB"
    endchoice

    config EXAMPLE_MIC_GAIN
        int
        default 0 if MIC_GAIN_0DB
        default 1 if MIC_GAIN_6DB
        default 2 if MIC_GAIN_12DB
        default 3 if MIC_GAIN_18DB
        default 4 if MIC_GAIN_24DB
        default 5 if MIC_GAIN_30DB
        default 6 if MIC_GAIN_36DB
        default 7 if MIC_GAIN_42DB

endmenu
```
